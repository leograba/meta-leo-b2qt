## conf/layer.conf
```bitbake
BBPATH .= ":${LAYERDIR}"

BBFILES += "${LAYERDIR}/recipes*/*/*.bb \
            ${LAYERDIR}/recipes*/*/*.bbappend \
            "

BBFILE_COLLECTIONS += "leo_b2qt"
BBFILE_PATTERN_leo_b2qt := "^${LAYERDIR}/"
BBFILE_PRIORITY_leo_b2qt = "20"
```
